#include <SPI.h> //Librería para usar el bus SPI
#include <Wire.h> //Librería que permite comunicarse al arduino por i2C (para usar la pantalla)
#include <Adafruit_GFX.h> //Librería para controlar la pantalla
#include <Adafruit_SSD1306.h> //Librería de la pantalla especifica a utilizar

//Definiendo características de la pantalla
#define ANCHO_PANTALLA 128
#define ALTO_PANTALLA 64
#define OLED_RESET -1
#define DIRECCION_PANTALLA 0x3C //Dirección de comunicación de la pantalla 128x64
Adafruit_SSD1306 display(ANCHO_PANTALLA,ALTO_PANTALLA,&Wire,OLED_RESET);

// Definiendo boton de arriba y abajo para jugador 1 y 2
#define boton1_arriba 12
#define boton1_abajo 9
#define boton2_arriba 6
#define boton2_abajo 3

// Definiendo la dificultad del juego
const unsigned long velocidad_paleta = 0;
const unsigned long velocidad_bola = 0;
const uint8_t altura_paleta = 15;

void dibujoCuadrado();

uint8_t bola_x = 64, bola_y = 32;
uint8_t direccion_bola_x = 2, direccion_bola_y = 1;
unsigned long actualizar_bola;
unsigned long actualizar_paleta;

boolean inicioJuego = true;
boolean reiniciarBola = false;

const uint8_t jugador1_x = 12;
uint8_t jugador1_y = 16;

const uint8_t jugador2_x = 116;
uint8_t jugador2_y = 16;

int PUNTUACION_MAX = 8;
int PUNTUACION_JUGADOR1 = 0;
int PUNTUACION_JUGADOR2 = 0;

int residuo = 0;

const unsigned char pong[] PROGMEM = {
	0x00, 0x00, 0x00, 0x00, 0x00, 0x00, 0x00, 0x00, 0x00, 0x00, 0x00, 0x00, 0x00, 0x00, 0x00, 0x00, 
	0x00, 0x00, 0x00, 0x00, 0x00, 0x00, 0x00, 0x00, 0x00, 0x00, 0x00, 0x00, 0x00, 0x00, 0x00, 0x00, 
	0x00, 0x00, 0x00, 0x00, 0x00, 0x00, 0x00, 0x00, 0x00, 0x00, 0x00, 0x00, 0x00, 0x00, 0x00, 0x00, 
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	0x00, 0x00, 0x00, 0x00, 0x00, 0x00, 0x00, 0x00, 0x00, 0x00, 0x00, 0x00, 0x00, 0x00, 0x00, 0x00
};

void setup(){
  // Definir los botones como entradas
  pinMode(boton1_arriba,INPUT);
  pinMode(boton1_abajo,INPUT);
  pinMode(boton2_arriba,INPUT);
  pinMode(boton2_abajo,INPUT);

  // Definir los botones en alto
  digitalWrite(boton1_arriba,1);
  digitalWrite(boton1_abajo,1);
  digitalWrite(boton2_arriba,1);
  digitalWrite(boton2_abajo,1);
  // Inicializar la pantalla
  Serial.begin(9600);
  display.begin(SSD1306_SWITCHCAPVCC,DIRECCION_PANTALLA);

  display.clearDisplay(); // Limpiar pantalla
  display.drawBitmap(0,0,pong,display.width(),display.height(),WHITE);
  display.display();

  while(digitalRead(boton1_arriba) == HIGH && digitalRead(boton1_abajo) == HIGH && digitalRead(boton2_arriba) == HIGH && digitalRead(boton2_abajo) == HIGH){
    delay(100);
  }

  unsigned long inicio = millis();

  display.clearDisplay();
  cuentaRegresiva();
  dibujoCuadrado();
  display.display();

  while(millis() - inicio < 2000);
  actualizar_bola = millis();
  actualizar_paleta = actualizar_bola;
  do{
    bola_x = random(56,86);
    residuo = bola_x % 2;
  } while(residuo != 0);
  do{
    bola_x = random(36,86);
    residuo = bola_x % 2;
  } while(residuo != 0);
}

void loop() {
  unsigned long tiempo = millis();

  static bool estado1_arriba = false;
  static bool estado1_abajo = false;
  static bool estado2_arriba = false;
  static bool estado2_abajo = false;
    
  estado1_arriba |= (digitalRead(boton1_arriba) == LOW); //estado1_arriba = estado1_arriba | (digitalRead(boton1_arriba)
  estado1_abajo |= (digitalRead(boton1_abajo) == LOW);
  estado2_arriba |= (digitalRead(boton2_arriba) == LOW);
  estado2_abajo |= (digitalRead(boton2_abajo) == LOW);

  if(reiniciarBola){
    display.drawPixel(bola_x, bola_y, BLACK);
    do{
      bola_x = random(56,86);
      residuo = bola_x % 2;
    } while(residuo != 0);
    do{
      bola_x = random(46,86);
      residuo = bola_x % 2;
    } while(residuo != 0);
    do{
      direccion_bola_x = random(-1,2);
      direccion_bola_x *= 2;
    } while(direccion_bola_x == 0); 
    do{
      direccion_bola_y = random(-1,2);
    } while(direccion_bola_y == 0); 
    reiniciarBola = false;
  }

  if(tiempo > actualizar_bola && inicioJuego){
    uint8_t nueva_x1 = bola_x + direccion_bola_x;
    uint8_t nueva_y1 = bola_y + direccion_bola_y;;

    // Comprobar si la bola golpea las paredes verticales
    if(nueva_x1 == 0){ // Jugador 1 obtiene un punto
      PUNTUACION_JUGADOR2++;
      if(PUNTUACION_JUGADOR2 == PUNTUACION_MAX){
        finalizarJuego();                
      }else{
        mostrarPuntuacion();
      }
    }
    // Comprobar si la bola golpea las paredes verticales
    if(nueva_x1 == 126){ // Jugador 2 obtiene un punto
      PUNTUACION_JUGADOR1++;
      if(PUNTUACION_JUGADOR1 == PUNTUACION_MAX){
        finalizarJuego();
      }else{
        mostrarPuntuacion();
      }
    }
 
    // Comprobar si la bola golpea las paredes horizontales
    if(nueva_y1 == 0 || nueva_y1 == 63){
      direccion_bola_y = -direccion_bola_y;
      nueva_y1 += direccion_bola_y + direccion_bola_y;
    }
           
    // Comprobar si la bola golpea la paleta del jugador 2
    if(nueva_x1 == jugador2_x && nueva_y1 >= jugador2_y && nueva_y1 <= jugador2_y + altura_paleta){
      direccion_bola_x = -direccion_bola_x;
      nueva_x1 += direccion_bola_x + direccion_bola_x;
    }

    if(nueva_x1 == 0 || nueva_x1 == 126){
      direccion_bola_x = -direccion_bola_x;
      nueva_x1 += direccion_bola_x + direccion_bola_x;
    }
           
    // Comprobar si la bola golpea la paleta del jugador 1
    if(nueva_x1 == jugador1_x && nueva_y1 >= jugador1_y && nueva_y1 <= jugador1_y + altura_paleta){
      direccion_bola_x = -direccion_bola_x;
      nueva_x1 += direccion_bola_x + direccion_bola_x;
    }

    display.drawPixel(bola_x, bola_y, BLACK);
    display.drawPixel(nueva_x1, nueva_y1, WHITE);
    display.display();
    bola_x = nueva_x1;
    bola_y = nueva_y1;
        
    actualizar_bola += velocidad_bola;
  }

  if(tiempo > actualizar_paleta && inicioJuego){
    actualizar_paleta += velocidad_paleta;

    // Paleta del jugador 2
    display.drawFastVLine(jugador2_x, jugador2_y, altura_paleta, BLACK);
    if(estado2_arriba){
      jugador2_y -= 1;
    }
    if(estado2_abajo){
      jugador2_y += 1;
    }
    estado2_arriba = estado2_abajo = false;
    if(jugador2_y < 1){
      jugador2_y = 1;
    }
    if(jugador2_y + altura_paleta > 63){
      jugador2_y = 63 - altura_paleta;
    }
    display.drawFastVLine(jugador2_x, jugador2_y, altura_paleta, WHITE);
        
    // Paleta del jugador 1
    display.drawFastVLine(jugador1_x, jugador1_y, altura_paleta, BLACK);
    if(estado1_arriba){
      jugador1_y -= 1;
    }
    if(estado1_abajo){
      jugador1_y += 1;
    }
    estado1_arriba = estado1_abajo = false;
    if(jugador1_y < 1){
      jugador1_y = 1;
    }
    if(jugador1_y + altura_paleta > 63){
      jugador1_y = 63 - altura_paleta;
    }
    display.drawFastVLine(jugador1_x, jugador1_y, altura_paleta, WHITE);
  }
}

void dibujoCuadrado(){
  display.drawRect(0, 0, 128, 64, WHITE);
}

void finalizarJuego(){
  inicioJuego = false;
  display.clearDisplay();
  dibujoCuadrado();
  display.display();

  if(PUNTUACION_JUGADOR1 > PUNTUACION_JUGADOR2){
    display.setCursor(22,9);
    display.setTextColor(WHITE);
    display.setTextSize(1);
    display.print("JUGADOR 1 GANA");
  }else{
    display.setCursor(22,9);
    display.setTextColor(WHITE);
    display.setTextSize(1);
    display.print("JUGADOR 2 GANA");
  }

  display.setCursor(36,30);
  display.setTextColor(WHITE);
  display.setTextSize(3);
  display.print(String(PUNTUACION_JUGADOR1));

  display.setCursor(76,30);
  display.setTextColor(WHITE);
  display.setTextSize(3);
  display.print(String(PUNTUACION_JUGADOR2));
  display.display();
  delay(2000);

  while(digitalRead(boton1_arriba) == HIGH && digitalRead(boton1_abajo) == HIGH && digitalRead(boton2_arriba) == HIGH && digitalRead(boton2_abajo)){
    delay(100);
  }

  inicioJuego = true;
  
  PUNTUACION_JUGADOR1 = PUNTUACION_JUGADOR2 = 0;

  unsigned long inicio = millis();
  display.clearDisplay();
  cuentaRegresiva();
  dibujoCuadrado();
  display.display();
  while(millis() - inicio < 2000);
  actualizar_bola = millis();    
  actualizar_paleta = actualizar_bola;
  inicioJuego = true;
  reiniciarBola = true;
}

void mostrarPuntuacion(){
  inicioJuego = false;
  display.clearDisplay();
  dibujoCuadrado();
  display.display();
  
  display.setCursor(35,9);
  display.setTextColor(WHITE);
  display.setTextSize(1);
  display.print("PUNTUACION");

  display.setCursor(36,30);
  display.setTextColor(WHITE);
  display.setTextSize(3);
  display.print(String(PUNTUACION_JUGADOR1));

  display.setCursor(76,30);
  display.setTextColor(WHITE);
  display.setTextSize(3);
  display.print(String(PUNTUACION_JUGADOR2));
  display.display();

  delay(2000);
  unsigned long inicio = millis();

  display.clearDisplay();
  dibujoCuadrado();
  display.display();
  while(millis() - inicio < 2000);
  actualizar_bola = millis();    
  actualizar_paleta = actualizar_bola;
  inicioJuego = true;
  reiniciarBola = true;
}

void cuentaRegresiva(){
  display.drawRoundRect(2, 2, 124, 60, 8, WHITE);
  display.drawRoundRect(4, 4, 120, 56, 8, WHITE);
  display.setTextSize(2);
  display.setTextColor(WHITE);
  display.setCursor(60, 25);
  display.println("3");
  display.display();
  display.clearDisplay();
  delay(1000);

  display.drawRoundRect(2, 2, 124, 60, 8, WHITE);
  display.drawRoundRect(4, 4, 120, 56, 8, WHITE);
  display.drawRoundRect(6, 6, 116, 52, 8, WHITE);
  display.setTextSize(2);
  display.setTextColor(WHITE);
  display.setCursor(60, 25);
  display.println("2");
  display.display();
  display.clearDisplay();
  delay(1000);

  display.drawRoundRect(2, 2, 124, 60, 8, WHITE);
  display.drawRoundRect(4, 4, 120, 56, 8, WHITE);
  display.drawRoundRect(6, 6, 116, 52, 8, WHITE);
  display.drawRoundRect(8, 8, 112, 48, 8, WHITE);
  display.setTextSize(2);
  display.setTextColor(WHITE);
  display.setCursor(60, 25);
  display.println("1");
  display.display();
  display.clearDisplay();
  delay(1000);

  display.drawRoundRect(2, 2, 124, 60, 8, WHITE);
  display.drawRoundRect(4, 4, 120, 56, 8, WHITE);
  display.drawRoundRect(6, 6, 116, 52, 8, WHITE);
  display.drawRoundRect(8, 8, 112, 48, 8, WHITE);
  display.drawRoundRect(10, 10, 108, 52, 8, WHITE);
  display.setTextSize(2);
  display.setTextColor(WHITE);
  display.setCursor(40, 22);
  display.println("GO!");
  display.display();
  display.clearDisplay();

  delay(1000);
}